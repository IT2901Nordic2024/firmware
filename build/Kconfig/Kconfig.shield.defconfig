## build/Kconfig/Kconfig.shield.defconfig
```kconfig
osource "/opt/nordic/ncs/v2.5.1/nrf/applications/firmware/boards/shields/*/Kconfig.defconfig"
osource "/opt/nordic/ncs/v2.5.1/nrf/boards/shields/*/Kconfig.defconfig"
```

## build_1/Kconfig/Kconfig.shield
```kconfig
osource "/opt/nordic/ncs/v2.5.1/nrf/applications/firmware/boards/shields/*/Kconfig.shield"
osource "/opt/nordic/ncs/v2.5.1/nrf/boards/shields/*/Kconfig.shield"
```
